## Kconfig
```kconfig
config PACKAGE_gpio-fan-rpm
	bool "gpio-fan-rpm"
	default n
	help
	  High-precision command-line utility for measuring fan RPM using GPIO pins
	  on OpenWRT devices.

	  Features:
	  - Edge-event-based RPM detection using libgpiod
	  - Multithreaded measurement for multiple GPIOs in parallel
	  - Warm-up phase to avoid initial inaccuracies
	  - Watch mode for continuous monitoring
	  - JSON, numeric and collectd-compatible output
	  - Auto-detection of GPIO chip if not specified

	  This package requires libgpiod, libjson-c, and libpthread.
```
